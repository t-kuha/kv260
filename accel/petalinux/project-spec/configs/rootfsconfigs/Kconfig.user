## accel/petalinux/project-spec/configs/rootfsconfigs/Kconfig.user
```kconfig
menu "user packages " 
config fuse-exfat  
	 bool "fuse-exfat"
	 help
	
config gpio-demo  
	 bool "gpio-demo"
	 help
	
config kv260-vadd  
	 bool "kv260-vadd"
	 help
	
config packagegroup-kria  
	 bool "packagegroup-kria"
	 help
	
config peekpoke  
	 bool "peekpoke"
	 help
	
config rtl8188eus  
	 bool "rtl8188eus"
	 help
	
endmenu
```
