## vitis-ai/petalinux/project-spec/configs/rootfsconfigs/Kconfig.user
```kconfig
menu "user packages " 
config fuse-exfat  
	 bool "fuse-exfat"
	 help
	
config gpio-demo  
	 bool "gpio-demo"
	 help
	
config packagegroup-petalinux-kria  
	 bool "packagegroup-petalinux-kria"
	 help
	
config peekpoke  
	 bool "peekpoke"
	 help
	
config rtl8188eus  
	 bool "rtl8188eus"
	 help
	
config target-factory  
	 bool "target-factory"
	 help
	
config unilog  
	 bool "unilog"
	 help
	
config vart  
	 bool "vart"
	 help
	
config vitis-ai-library  
	 bool "vitis-ai-library"
	 help
	
config xir  
	 bool "xir"
	 help
	
endmenu
```
